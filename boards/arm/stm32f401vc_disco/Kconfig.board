## boards/arm/stm32f401vc_disco/Kconfig.board
```kconfig
# STM32F401VC-DISCO board configuration

config BOARD_STM32F401VC_DISCO
	bool "STM32F401VC-DISCO Development Board"
	depends on SOC_STM32F401XC
```

## boards/arm/stm32f401vc_disco/Kconfig.defconfig
```kconfig
# STM32F401VC-DISCO board configuration

if BOARD_STM32F401VC_DISCO

config BOARD
	default "stm32f401vc_disco"

endif # BOARD_STM32F401VC_DISCO
```
